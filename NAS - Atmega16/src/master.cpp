/*
 * master.cpp
 *
 * Created: 1/1/2025 2:19:33 AM
 *  Author: momen
 */

#include "master.h"

/*
 * default constructor to Initiate the TWI bus.
 */
Master::Master()
{
    // clear prescalar bit.
    TWSR &= ~((1 << TWPS0) | (1 << TWPS1));
    // CPU's frequency is 16MHz, SCL frequency is 1MHz. So, (16 - 16) / 2 = 0; since prescalar bits are cleared.
    TWBR = 0;
}

/*
 * Writes to TWCR in order to initiate transmission of START condition, which make the MCU enters Master mode.
 * Returns:
 *  - status code of the START condition.
 */
int8_t Master::tstart()
{
    // TWIN, TWSTA, TWEN should be set to 1 in order to send START condition
    TWCR = (1 << TWINT) | (1 << TWSTA) | (1 << TWEN); // note that 1 clears the TWINT flag (idk, this is how TWI module works).

    // After transmitting the START condition, the TWINT flag is set by hardware, and TWSR is updated. the second step is to send SLA packet.
    // waiting until the hardware set the TWINT flag (which means the START condition is sent):
    while (!(TWCR & (1 << TWINT)));

    // TWSR has been updated, we have to return a status code based on it's value.
    return TWSR & 0xF8; // masking the three LSBs, TWPS0, TWPS1 (prescalar bits) and a reserved bit which always set to 0.
}

/*
 * issues a STOP condition in order to terminate the session.
 */
void Master::tstop()
{
    // a STOP condition is generated by setting the TWSTO flag, as well as TWINT and TWEN to send the condition.
    TWCR = (1 << TWINT) | (1 << TWSTO) | (1 << TWEN);
    // note that the TWINT is NOT set after a STOP condition has been sent.

    // TWSTO flag will be reset after sending a STOP condition.
    while ((TWCR & (1 << TWSTO))); // wait until stop transmitted
}

/*
 * sends SLA+W packet, making the MCU enters Master Transmitter mode.
 * parameters:
 *  - addr: the address of the slave we need to write to it.
 * returns:
 *  - status code of address acknowledgment or transmission error.
 */
int8_t Master::tslaw(uint8_t addr)
{
    // in order to enter Master Transmitter mode, SLA+W should be transmitted. this is done by writing SLA+W to TWDR.
    TWDR = (addr << 1) | 0; // SLA+W packet has 7 MSB bits as address bits, and the LSB describes R/W operation.

    // thereafter, the TWINT flag should be cleared (by setting it to 1) to continue the transfer.
    TWCR = (1 << TWINT) | (1 << TWEN);

    // TWINT will be set by hardware as soon as the transmission completes.
    // wait until TWINT flag is set:
    while (!(TWCR & (1 << TWINT)));

    // return the status code
    return TWSR & 0xF8;
}

/*
 * sends SLA+R packet, making the MCU enters Master Receiver mode.
 * parameters:
 *  - addr: the address of the slave we need to read from it.
 * returns:
 *  - status code of address acknowledgment or transmission error.
 */
int8_t Master::tslar(uint8_t addr)
{
    // in order to enter Master Receiver mode, SLA+R should be transmitted. this is done by writing SLA+R to TWDR.
    TWDR = (addr << 1) | 1; // SLA+R packet has 7 MSB bits as address bits, and the LSB describes R/W operation.

    // thereafter, the TWINT flag should be cleared (by setting it to 1) to continue the transfer.
    TWCR = (1 << TWINT) | (1 << TWEN);

    // TWINT will be set by hardware as soon as the transmission completes.
    // wait until TWINT flag is set:
    while (!(TWCR & (1 << TWINT)));

    // return the status code
    return TWSR & 0xF8;
}

/*
 * writes a data packet on the bus in Master Transmitter mode.
 * parameters:
 *  - data: a byte (char) to be transmitted
 * returns:
 *  - status code of the transmission.
 */
int8_t Master::ttx(char data)
{
    // when the SLA+W has been successfully transmitted, a data packet should be transmitted.
    // this is done by writing a data byte to TWDR. TWDR must only be written when the TWINT is high.
    // i think it's okay to write into TWDR here immediately, since the previous called tslaw() function does not proceed until it checks the TWINT flag.
    TWDR = data;

    // TWINT should be cleared (by writing it to 1) to continue the transmission
    TWCR = (1 << TWINT) | (1 << TWEN);

    // wait until finishing the transmission:
    while (!(TWCR & (1 << TWINT)));

    // return the status code
    return TWSR & 0xF8;
}

/*
 * Receive a data byte from the bus.
 * parameters:
 *  - ea: Enable acknowledgment, 1 sends ACK, 0 sends NACK. necessary for session termination.
 * returns:
 *  - the status code of the reception.
 */
int8_t Master::trx(bool ea)
{
    // in order to receive a data byte, TWINT should be cleared (by writing it to 1).
    TWCR = (1 << TWINT) | (ea << TWEA) | (1 << TWEN); // TWEA enables acknowledgment. this line means data byte will be received, ACK will be returned.

    // wait until TWINT set high by hardware (which means the data loaded into TWDR if the transmission succeed).
    while (!(TWCR & (1 << TWINT))); 

    // return status code.
    return TWSR & 0xF8;
}
